## Kconfig
```kconfig
config SIDE48_INPUT_PROCESSOR_SPIKE_FILTER
    bool "Drop physically impossible pointer deltas"
    default y
    depends on DT_HAS_SIDE48_INPUT_PROCESSOR_SPIKE_FILTER_ENABLED
    help
      The PMW3610 can return garbage motion right after waking from its
      rest modes: a burst of values near the 12 bit range with randomly
      alternating signs, which throws the cursor across the screen. Zero
      out events above the configured threshold, plus everything within a
      short window after one, so the rest of the burst is swallowed too.
      Ported from LiTom.
```

## config/west.yml
```yaml
manifest:
  remotes:
    - name: zmkfirmware
      url-base: https://github.com/zmkfirmware
    - name: powerenterkey
      url-base: https://github.com/PowerEnterKey
    - name: caksoylar  # RGB LED
      url-base: https://github.com/caksoylar  
    - name: badjeff    # PMW3610
      url-base: https://github.com/badjeff
    - name: mjmjm0101  # 慣性スクロール (LiTom と同じ)
      url-base: https://github.com/mjmjm0101
  projects:
    - name: zmk
      remote: zmkfirmware
      revision: v0.3
      import: app/west.yml
    - name: zmk-rgbled-widget
      remote: caksoylar
      revision: v0.3-branch
    - name: zmk-pmw3610-driver
      remote: badjeff
      revision: main
    # LiTom と同じく SHA で固定 (可動ブランチだと本家の更新で不意に壊れるため)
    - name: zmk-input-processor-scroll-inertia
      remote: mjmjm0101
      revision: f7dadefee453d555fe066d13a3de3bb60739b45e
  self:
    path: config
```
